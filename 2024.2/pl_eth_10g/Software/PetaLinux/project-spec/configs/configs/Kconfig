## 2024.2/pl_eth_10g/Software/PetaLinux/project-spec/configs/configs/Kconfig
```kconfig
mainmenu "PetaLinux System Configuration"
config SUBSYSTEM_TYPE_LINUX
        bool
        default y
        select SYSTEM_ZYNQMP

config SYSTEM_ZYNQMP
        bool "ZYNQMP Configuration"
        help
          ZYNQMP Configuration for petalinux project.
          All these config options will be in /home/elya/Public/ZCU102-Ethernet-main/2024.2/pl_eth_10g/Software/PetaLinux/project-spec/configs/config

config SUBSYSTEM_VARIANT_ZYNQMPEG
        bool
        default y
        help

config SUBSYSTEM_DISTRO_PETALINUX
        bool
        default y
        help

source /home/elya/Public/ZCU102-Ethernet-main/2024.2/pl_eth_10g/Software/PetaLinux/project-spec/configs/configs/Kconfig.main
```

## 2024.2/pl_eth_10g/Software/PetaLinux/project-spec/configs/rootfsconfigs/Kconfig.user
```kconfig
menu "user packages " 
config ethtool  
	 bool "ethtool"
	 help
	
config gpio-demo  
	 bool "gpio-demo"
	 help
	
config iperf3  
	 bool "iperf3"
	 help
	
config peekpoke  
	 bool "peekpoke"
	 help
	
config phytool  
	 bool "phytool"
	 help
	
endmenu
```
